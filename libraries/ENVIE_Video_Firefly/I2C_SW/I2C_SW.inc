; file: I2C_SW.inc
; description: software-emulated I2C timing definitions

$INCLUDE (config.inc)

; Timings for the I2C bus, in ns
IF I2C_STANDARD_MODE
    I2C_T_SU_STA    EQU     4700
    I2C_T_HD_STA    EQU     4000
    I2C_T_LOW       EQU     4700
    I2C_T_HIGH      EQU     4000
    I2C_T_SU_DAT    EQU     250
    I2C_T_HD_DAT    EQU     0
    I2C_T_VD_ACK    EQU     3450
    I2C_T_VD_DAT    EQU     3450
    I2C_T_SU_STO    EQU     4000
    I2C_T_BUF       EQU     4700
ELSEIF I2C_FAST_MODE
    I2C_T_SU_STA    EQU     600
    I2C_T_HD_STA    EQU     (600 + 189)
    I2C_T_LOW       EQU     (1300 + 410)
    I2C_T_HIGH      EQU     (600 + 189)
    I2C_T_SU_DAT    EQU     100
    I2C_T_HD_DAT    EQU     300
    I2C_T_VD_ACK    EQU     3450
    I2C_T_VD_DAT    EQU     3450
    I2C_T_SU_STO    EQU     600
    I2C_T_BUF       EQU     1300
ELSEIF I2C_FAST_MODE_PLUS
    I2C_T_SU_STA    EQU     260
    I2C_T_HD_STA    EQU     260
    I2C_T_LOW       EQU     500
    I2C_T_HIGH      EQU     260
    I2C_T_SU_DAT    EQU     50
    I2C_T_HD_DAT    EQU     0
    I2C_T_VD_ACK    EQU     3450
    I2C_T_VD_DAT    EQU     3450
    I2C_T_SU_STO    EQU     260
    I2C_T_BUF       EQU     500
ENDIF
; only for single clock cycle
CY_I2C_T_SU_STA     EQU     I2C_T_SU_STA * (FOSC / 1000) / 1000000
CY_I2C_T_HD_STA     EQU     I2C_T_HD_STA * (FOSC / 1000) / 1000000
CY_I2C_T_LOW        EQU     I2C_T_LOW * (FOSC / 1000) / 1000000
CY_I2C_T_HIGH       EQU     I2C_T_HIGH * (FOSC / 1000) / 1000000
CY_I2C_T_HD_DAT     EQU     I2C_T_HD_DAT * (FOSC / 1000) / 1000000
CY_I2C_T_SU_STO     EQU     I2C_T_SU_STO * (FOSC / 1000) / 1000000
CY_I2C_T_BUF        EQU     I2C_T_BUF * (FOSC / 1000) / 1000000


DELAY_CY MACRO CYCLE
    REPT CYCLE
    NOP
    ENDM
ENDM

DELAY_T_SU_STA MACRO ADJ
    IF ADJ >= CY_I2C_T_SU_STA
        EXITM
    ENDIF
    DELAY_CY(CY_I2C_T_SU_STA - ADJ)
ENDM

DELAY_T_HD_STA MACRO ADJ
    IF ADJ >= CY_I2C_T_HD_STA
        EXITM
    ENDIF
    DELAY_CY(CY_I2C_T_HD_STA - ADJ)
ENDM

DELAY_T_BUF MACRO ADJ
    IF ADJ >= CY_I2C_T_BUF
        EXITM
    ENDIF
    DELAY_CY(CY_I2C_T_BUF - ADJ)
ENDM

DELAY_T_HIGH MACRO ADJ
    IF ADJ >= CY_I2C_T_HIGH
        EXITM
    ENDIF
    DELAY_CY(CY_I2C_T_HIGH - ADJ)
ENDM

DELAY_T_LOW MACRO ADJ
    IF ADJ >= CY_I2C_T_LOW
        EXITM
    ENDIF
    DELAY_CY(CY_I2C_T_LOW - ADJ)
ENDM

DELAY_T_HD_DAT MACRO ADJ
    IF ADJ >= CY_I2C_T_HD_DAT
        EXITM
    ENDIF
    DELAY_CY(CY_I2C_T_HD_DAT - ADJ)
ENDM

DELAY_T_SU_STO MACRO ADJ
    IF ADJ >= CY_I2C_T_SU_STO
        EXITM
    ENDIF
    DELAY_CY(CY_I2C_T_SU_STO - ADJ)
ENDM

